// behaviors.dtsi
// Include this file in your keymap.dtsi

/ {
    behaviors {
        nice_view_behavior: behavior_nice_view {
            compatible = "zmk,behavior-nice-view";
            #binding-cells = <0>;
            display = <&nice_view>;
            widgets = <&layer_status &battery_status &output_status>;
        };
    };
};
